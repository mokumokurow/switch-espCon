## sdkconfig.defaults
```kconfig
# Bluetooth: Classic BT only (no BLE)
CONFIG_BT_ENABLED=y
CONFIG_ESPHID_TASK_SIZE_BT=8192
CONFIG_BT_CLASSIC_ENABLED=y
CONFIG_BT_HID_ENABLED=y
CONFIG_BT_HID_DEVICE_ENABLED=y
CONFIG_BT_SSP_ENABLED=y
CONFIG_BTDM_CTRL_MODE_BR_EDR_ONLY=y
# CONFIG_BT_BLE_ENABLED is not set
# CONFIG_BT_NIMBLE_ENABLED is not set
```
